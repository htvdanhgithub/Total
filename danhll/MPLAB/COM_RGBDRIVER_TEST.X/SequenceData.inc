;

;	Sequence Data Format
; --------------------
;	fade_rate, hold_time, red, green, blue (all values in decimal)
;	values should be 0 <= value <= 255
;
;	End of current sequence
;	-----------------------
;	fade_rate = 255 tells code that this is then end of the current
;	sequence data.
;
;	End of all sequence data
;	------------------------
;	fade_rate and hold_time = 255 tells the code that this is the end
; 	of the current sequence data AND the end of all sequences.
;
;	Fade Rate
;	---------
;	fade_rate = 0 --> no fade, new values update immediateley
;	fade_rate >0 and <255 fades from current to new values.
;	The colours fade from the current value to the new value
;	in steps of 1 (i.e. 0 to 100 requires 100 steps)
;	each step takes ~5mS x Fade Rate.
;
;	max fade time with increments of 5mS x fade_rate.
;	  1 x 5mS x 255 = 1.27 secs
;	  2 x 5mS x 255 = 2.50 secs
;	  3 x 5mS x 255 = 3.85 secs
;	  4 x 5mS x 255 = 5.10 secs
;	  5 x 5mS x 255 = 6.35 secs
;   6 x 5mS x 255 = 7.60 secs
;   ......
; 254 x 5mS x 255 = 3m23s
;
;	Hold Time
;	---------
;	How long to hold the current RGB colours before getting
; 	the next set of RGB values.
; 	hold_time = 0 --> no hold, jump to next step in sequence
;	hold_time >0 and <255 hold for 50ms x hold_time
;	1   x 50mS = 50mS
;	254 x 50mS = 12.7 secs
;
;	     |---------------------- Fade Rate
;      |    |----------------- Hold time
;      |    |    |------------ Red
;      |    |    |    |------- Green
;      |    |    |    |    |-- Blue
;      |    |    |    |    |


;;;;;;;;;;Original;;;;;;;;;;;;;;;;;;;;;;
;	dt   5,  2000, 255,  60,   0    ;1 Cam
;	dt   0,   5,   0,   0,   0
;	dt   5,  2000, 255,  48,   0    ;2
;	dt   0,   5,   0,   0,   0
;	dt   5,  2000, 255,  36,   0    ;3
;	dt   0,   5,   0,   0,   0
;	dt   5,  2000, 255,  24,   0    ;4
;	dt   0,   5,   0,   0,   0
;	dt   5,  2000, 255,  12,   0    ;5
;	dt   0,   5,   0,   0,   0
;	
;
;	dt   5,  2000, 255,   6,   0    ;1 Bordaux
;	dt   0,   5,   0,   0,   0
;	dt   5,  2000, 255,   4,   0    ;2
;	dt   0,   5,   0,   0,   0
;	dt   5,  2000, 255,   2,   0    ;3
;	dt   0,   5,   0,   0,   0
;
;	dt   5,  2000, 255,   0,   0    ;1 Hong
;	dt   0,   5,   0,   0,   0
;	dt   5,  2000, 255,   0,   5    ;2
;	dt   0,   5,   0,   0,   0
;	dt   5,  2000, 255,   0,  10    ;3
;	dt   0,   5,   0,   0,   0
;	dt   5,  2000, 255,   0,  15    ;4
;	dt   0,   5,   0,   0,   0
;	dt   5,  2000, 255,   0,  20    ;5
;	dt   0,   5,   0,   0,   0
;	dt   5,  2000, 255,   0,  25    ;6
;	dt   0,   5,   0,   0,   0
;	dt   5,  2000, 255,   0,  30    ;7
;	dt   0,   5,   0,   0,   0
;
;	dt   5,  2000, 255,   0,  40    ;1 
;	dt   0,   5,   0,   0,   0
;	dt   5,  2000, 255,   0,  83    ;2
;	dt   0,   5,   0,   0,   0
;	dt   5,  2000, 255,   0, 126    ;3
;	dt   0,   5,   0,   0,   0
;	dt   5,  2000, 255,   0, 169    ;4
;	dt   0,   5,   0,   0,   0
;	dt   5,  2000, 255,   0, 212    ;5
;	dt   0,   5,   0,   0,   0
;
;	dt   5,  2000, 255,   0, 255    ;1
;	dt   0,   5,   0,   0,   0
;	dt   5,  2000, 204,   0, 255    ;2
;	dt   0,   5,   0,   0,   0
;	dt   5,  2000, 153,   0, 255    ;3
;	dt   0,   5,   0,   0,   0
;	dt   5,  2000, 102,   0, 255    ;4
;	dt   0,   5,   0,   0,   0
;	dt   5,  2000,  51,   0, 255    ;5
;	dt   0,   5,   0,   0,   0
;
;	dt   5,  2000,   0,   0, 255    ;1
;	dt   0,   5,   0,   0,   0
;	dt   5,  2000,   0,  51, 255    ;2
;	dt   0,   5,   0,   0,   0
;	dt   5,  2000,   0, 102, 255    ;3
;	dt   0,   5,   0,   0,   0
;	dt   5,  2000,   0, 153, 255    ;4
;	dt   0,   5,   0,   0,   0
;	dt   5,  2000,   0, 204, 255    ;5
;	dt   0,   5,   0,   0,   0
;
;	dt   5,  2000,   0, 255, 255    ;1
;	dt   0,   5,   0,   0,   0
;	dt   5,  2000,   0, 255, 204    ;2
;	dt   0,   5,   0,   0,   0
;	dt   5,  2000,   0, 255, 153    ;3
;	dt   0,   5,   0,   0,   0
;	dt   5,  2000,   0, 255, 102    ;4
;	dt   0,   5,   0,   0,   0
;	dt   5,  2000,   0, 255,  51    ;5
;	dt   0,   5,   0,   0,   0
;
;	dt   5,  2000,   0, 255,   0    ;1
;	dt   0,   5,   0,   0,   0
;	dt   5,  2000,  51, 255,   0    ;2
;	dt   0,   5,   0,   0,   0
;	dt   5,  2000, 102, 255,   0    ;3
;	dt   0,   5,   0,   0,   0
;	dt   5,  2000, 153, 255,   0    ;4
;	dt   0,   5,   0,   0,   0
;	dt   5,  2000, 204, 255,   0    ;5
;	dt   0,   5,   0,   0,   0
;	
;	dt   5,  2000, 255, 255,   0    ;1
;	dt   0,   5,   0,   0,   0
;	dt   5,  2000, 255, 220,   0    ;2
;	dt   0,   5,   0,   0,   0
;	dt   5,  2000, 255, 186,   0    ;3
;	dt   0,   5,   0,   0,   0
;	dt   5,  2000, 255, 151,   0    ;4
;	dt   0,   5,   0,   0,   0
;	dt   5,  2000, 255, 117,   0    ;5
;	dt   0,   5,   0,   0,   0
;
;	dt   5,  2000, 255,  83,   0    ;1
;	dt   0,   5,   0,   0,   0
;	dt   5,  2000, 255,  78,   0    ;2
;	dt   0,   5,   0,   0,   0
;	dt   5,  2000, 255,  73,   0    ;3
;	dt   0,   5,   0,   0,   0
;	dt   5,  2000, 255,  69,   0    ;4
;	dt   0,   5,   0,   0,   0
;	dt   5,  2000, 255,  64,   0    ;5
;	dt   0,   5,   0,   0,   0
;;;;;;;;;;;Original;;;;;;;;;;;;;;;;;;;;;;
;
;
;	dt   5,  2000, 214,   0, 147    ;1
;	dt   0,   5,   0,   0,   0
;	dt   5,  2000, 181,   0, 122    ;2
;	dt   0,   5,   0,   0,   0
;	dt   5,  2000, 148,   0,  98    ;3
;	dt   0,   5,   0,   0,   0
;	dt   5,  2000, 115,   0,  73    ;4
;	dt   0,   5,   0,   0,   0
;	dt   5,  2000,  82,   0,  49    ;5
;	dt   0,   5,   0,   0,   0

	dt   5,  2000, 255,   0,  25    ;6
	dt   0,   5,   0,   0,   0
	
	dt   5,  2000,   0, 255, 102    ;4
	dt   0,   5,   0,   0,   0
	
	dt   5,  2000, 255,  60,   0    ;1 Cam
	dt   0,   5,   0,   0,   0
	
	dt   5,  2000, 255,   4,   0    ;2
	dt   0,   5,   0,   0,   0
	
	dt   5,  2000, 255,  48,   0    ;2
	dt   0,   5,   0,   0,   0
	
	dt   5,  2000,   0, 102, 255    ;3
	dt   0,   5,   0,   0,   0
	
	dt   5,  2000, 214,   0, 147    ;1
	dt   0,   5,   0,   0,   0
	
	dt   5,  2000,  82,   0,  49    ;5
	dt   0,   5,   0,   0,   0
	
	dt   5,  2000, 255,   2,   0    ;3
	dt   0,   5,   0,   0,   0
	
	dt   5,  2000, 255,   0, 126    ;3
	dt   0,   5,   0,   0,   0
	
	dt   5,  2000, 255,   6,   0    ;1 Bordaux
	dt   0,   5,   0,   0,   0
	
	dt   5,  2000, 255, 151,   0    ;4
	dt   0,   5,   0,   0,   0
	
	dt   5,  2000,   0, 255,   0    ;1
	dt   0,   5,   0,   0,   0
	
	dt   5,  2000, 255,  36,   0    ;3
	dt   0,   5,   0,   0,   0
	
	dt   5,  2000, 255,  83,   0    ;1
	dt   0,   5,   0,   0,   0
	
	dt   5,  2000, 255,  73,   0    ;3
	dt   0,   5,   0,   0,   0
	
	dt   5,  2000,   0, 255,  51    ;5
	dt   0,   5,   0,   0,   0
	
	dt   5,  2000, 153,   0, 255    ;3
	dt   0,   5,   0,   0,   0
	
	dt   5,  2000, 255,  12,   0    ;5
	dt   0,   5,   0,   0,   0
	
	dt   5,  2000, 255, 186,   0    ;3
	dt   0,   5,   0,   0,   0
	
	dt   5,  2000, 255,   0,   5    ;2
	dt   0,   5,   0,   0,   0
	
	dt   5,  2000, 181,   0, 122    ;2
	dt   0,   5,   0,   0,   0
	
	dt   5,  2000,  51, 255,   0    ;2
	dt   0,   5,   0,   0,   0
	
	dt   5,  2000, 102,   0, 255    ;4
	dt   0,   5,   0,   0,   0
	
	dt   5,  2000, 204, 255,   0    ;5
	dt   0,   5,   0,   0,   0
	
	dt   5,  2000, 255,   0, 255    ;1
	dt   0,   5,   0,   0,   0
	
	dt   5,  2000, 255,   0,  20    ;5
	dt   0,   5,   0,   0,   0
	
	dt   5,  2000, 255,   0,   0    ;1 Hong
	dt   0,   5,   0,   0,   0
	
	dt   5,  2000, 255,   0,  15    ;4
	dt   0,   5,   0,   0,   0
	
	dt   5,  2000, 153, 255,   0    ;4
	dt   0,   5,   0,   0,   0
	
	dt   5,  2000, 255, 220,   0    ;2
	dt   0,   5,   0,   0,   0
	
	dt   5,  2000, 255,   0, 212    ;5
	dt   0,   5,   0,   0,   0
	
	dt   5,  2000,   0, 255, 255    ;1
	dt   0,   5,   0,   0,   0
	
	dt   5,  2000,  51,   0, 255    ;5
	dt   0,   5,   0,   0,   0
	
	dt   5,  2000, 255,  78,   0    ;2
	dt   0,   5,   0,   0,   0
	
	dt   5,  2000,   0, 153, 255    ;4
	dt   0,   5,   0,   0,   0
	
	dt   5,  2000,   0, 255, 204    ;2
	dt   0,   5,   0,   0,   0
	
	dt   5,  2000, 255,   0,  10    ;3
	dt   0,   5,   0,   0,   0
	
	dt   5,  2000, 255, 117,   0    ;5
	dt   0,   5,   0,   0,   0
	
	dt   5,  2000, 255,  69,   0    ;4
	dt   0,   5,   0,   0,   0
	
	dt   5,  2000, 204,   0, 255    ;2
	dt   0,   5,   0,   0,   0
	
	dt   5,  2000,   0,  51, 255    ;2
	dt   0,   5,   0,   0,   0
	
	dt   5,  2000, 102, 255,   0    ;3
	dt   0,   5,   0,   0,   0
	
	dt   5,  2000, 255, 255,   0    ;1
	dt   0,   5,   0,   0,   0
	
	dt   5,  2000,   0, 255, 153    ;3
	dt   0,   5,   0,   0,   0
	
	dt   5,  2000, 255,   0,  83    ;2
	dt   0,   5,   0,   0,   0
	
	dt   5,  2000,   0, 204, 255    ;5
	dt   0,   5,   0,   0,   0
	
	dt   5,  2000, 255,   0,  30    ;7
	dt   0,   5,   0,   0,   0
	
	dt   5,  2000, 115,   0,  73    ;4
	dt   0,   5,   0,   0,   0
	
	dt   5,  2000, 148,   0,  98    ;3
	dt   0,   5,   0,   0,   0
	
	dt   5,  2000, 255,  64,   0    ;5
	dt   0,   5,   0,   0,   0
	
	dt   5,  2000, 255,   0, 169    ;4
	dt   0,   5,   0,   0,   0
	
	dt   5,  2000, 255,   0,  40    ;1 
	dt   0,   5,   0,   0,   0
	
	dt   5,  2000, 255,  24,   0    ;4
	dt   0,   5,   0,   0,   0
	
	dt   5,  2000,   0,   0, 255    ;1
	dt   0,   5,   0,   0,   0
	

	dt 255		; 
	dt 255		; end of all data


